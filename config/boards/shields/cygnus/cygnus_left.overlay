/*
 * Copyright (c) 2020 Pete Johanson
 *
 * SPDX-License-Identifier: MIT
 */

#include "cygnus.dtsi"

&kscan0 {
    col-gpios
        = <&gpio1 14 GPIO_ACTIVE_HIGH> 
        , <&gpio0 6 GPIO_ACTIVE_HIGH>
        , <&gpio0 15 GPIO_ACTIVE_HIGH>
        , <&gpio0 20 GPIO_ACTIVE_HIGH>
        , <&gpio0 22 GPIO_ACTIVE_HIGH>
        ;
};
